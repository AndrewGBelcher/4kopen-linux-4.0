/*
 * Copyright (C) 2015 STMicroelectronics (R&D) Limited.
 * Author: Pankaj Dev <pankaj.dev@st.com>
 *
 * This program is free software; you can redistribute it and/or modify
 * it under the terms of the GNU General Public License version 2 as
 * published by the Free Software Foundation.
 */
/dts-v1/;
#include "stih314.dtsi"
#include "stihxxx-b2188.dtsi"
/ {
	model = "STiH314 B2188";
	compatible = "st,stih314-b2188", "st,stih418", "st,stih410";

	memory {
		device_type = "memory";
		reg = <0x80000000 0x80000000>;
	};

	pwm_regulator: pwm-regulator {
		compatible = "st,pwm-regulator";
		status = "okay";
		pwms = <&pwm1 3 8448>;
	};
};
