/*
 * Copyright (C) 2014 STMicroelectronics (R&D) Limited.
 * Author: Maxime Coquelin <maxime.coquelin@st.com>
 *
 * This program is free software; you can redistribute it and/or modify
 * it under the terms of the GNU General Public License version 2 as
 * published by the Free Software Foundation.
 */
#include "stihxxx-b2199.dtsi"
/ {
	soc {
		/* audio dac buffer */
		i2c@9845000 {
			#address-cells = <1>;
			#size-cells = <0>;

			snd_dac_buffer@4a {
				compatible = "st6440";
				reg = <0x4a>;
				st,source-bus-id = <&snd_uni_player2>;
				st,buffer-gain = <2>;
			};

		};
	};
};
