/*
 * Copyright (C) 2015 STMicroelectronics (R&D) Limited.
 * Author: Pankaj Dev <pankaj.dev@st.com>
 *
 * This program is free software; you can redistribute it and/or modify
 * it under the terms of the GNU General Public License version 2 as
 * published by the Free Software Foundation.
 */
#include "stih418.dtsi"
#include "stih414-clkconf.dtsi"
/ {
	clocks {
		compatible = "st,stih414-clk", "simple-bus";
	};
	soc {
		sti_cpufreq_init {
			compatible = "st,stih407-cpufreq-init";
			st,operating-points = <
				/* kHz */
				800000 500000
			 >;
		};
	};
};
