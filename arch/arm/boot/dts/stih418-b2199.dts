/*
 * Copyright (C) 2014 STMicroelectronics (R&D) Limited.
 * Author: Maxime Coquelin <maxime.coquelin@st.com>
 *
 * This program is free software; you can redistribute it and/or modify
 * it under the terms of the GNU General Public License version 2 as
 * published by the Free Software Foundation.
 */
/dts-v1/;
#include "stih418.dtsi"
#include "stihxxx-b2199.dtsi"
/ {
	model = "STiH418 B2199";
	compatible = "st,stih418-b2199", "st,stih418", "st,stih410";

	memory {
		device_type = "memory";
		reg = <0x40000000 0xc0000000>;
	};

	pwm_regulator: pwm-regulator {
		compatible = "st,pwm-regulator";
		status = "okay";
		pwms = <&pwm1 3 8448>;
	};
};
