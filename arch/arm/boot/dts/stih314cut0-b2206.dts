/*
 * Copyright (C) 2014 STMicroelectronics (R&D) Limited.
 * Author: Allen Wu <allen.wu@st.com>
 *
 * This program is free software; you can redistribute it and/or modify
 * it under the terms of the GNU General Public License version 2 as
 * published by the Free Software Foundation.
 */
/dts-v1/;
#include "stih410.dtsi"
#include "stihxxx-b2206.dtsi"
/ {
	model = "STiH314 Cut0 B2206";
	compatible = "st,stih314cut0-b2206", "st,stih314cut0", "st,stih410";

	memory {
		device_type = "memory";
		reg = <0x40000000 0x80000000>;
	};
};
