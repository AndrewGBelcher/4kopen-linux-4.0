/*
 * Copyright (C) 2015 STMicroelectronics
 * Author: Pankaj Dev <pankaj.dev@st.com>
 *
 * This program is free software; you can redistribute it and/or modify
 * it under the terms of the GNU General Public License version 2 as
 * published by the Free Software Foundation.
 */
#include "stih418-clks.h"
/ {
	clocks {
						/* Clockgen D0 */
		assigned-clocks =   		<&CLK_S_D0_QUADFS VCO>,
						<&CLK_S_D0_QUADFS 0>,
						<&CLK_S_D0_FLEXGEN CLK_PCM_0>,
						<&CLK_S_D0_QUADFS 1>,
						<&CLK_S_D0_FLEXGEN CLK_PCM_1>,
						<&CLK_S_D0_QUADFS 2>,
						<&CLK_S_D0_FLEXGEN CLK_PCM_2>,
						<&CLK_S_D0_QUADFS 3>,
						<&CLK_S_D0_FLEXGEN CLK_SPDIFF>,
						/* Clockgen D2 */
						<&CLK_S_D2_QUADFS VCO>,
						<&CLK_S_D2_QUADFS 2>,
						<&CLK_S_D2_QUADFS 3>,
						<&CLK_S_D2_FLEXGEN CLK_VP9>,
						/* Clockgen D3 */
						<&CLK_S_D3_QUADFS VCO>,
						<&CLK_S_D3_QUADFS 0>,
						<&CLK_S_D3_FLEXGEN CLK_STFE_FRC1>,
						<&CLK_S_D3_FLEXGEN CLK_FRC1_REMOTE>,
						<&CLK_S_D3_QUADFS 1>,
						<&CLK_S_D3_FLEXGEN CLK_TSOUT_0>,
						<&CLK_S_D3_FLEXGEN CLK_TSOUT_1>,
						<&CLK_S_D3_FLEXGEN CLK_MCHI>,
						<&CLK_S_D3_FLEXGEN CLK_LPC_0>,
						/* Clockgen C0 */
						<&CLK_S_C0_QUADFS 2>,
						<&CLK_S_C0_FLEXGEN CLK_DSS_LPC>,
						<&CLK_S_C0_FLEXGEN CLK_MMC_0>,
						<&CLK_S_C0_QUADFS 3>,
						<&CLK_S_C0_FLEXGEN CLK_ETH_PHYREF>,
						<&CLK_S_C0_FLEXGEN CLK_ETH_PHY>,
						<&CLK_S_C0_FLEXGEN CLK_ICN_GPU>,
						<&CLK_S_C0_FLEXGEN CLK_PP_DMU>,
						<&CLK_S_C0_FLEXGEN CLK_VID_DMU>,
						<&CLK_S_C0_FLEXGEN CLK_ST231_DMU>,
						<&CLK_S_C0_FLEXGEN CLK_HWPE_HEVC>,
						<&CLK_S_C0_FLEXGEN CLK_PROC_SC>;

						/* Clockgen D0 */
		assigned-clock-parents =	<0>,
						<0>,
						<&CLK_S_D0_QUADFS 0>,
						<0>,
						<&CLK_S_D0_QUADFS 1>,
						<0>,
						<&CLK_S_D0_QUADFS 2>,
						<0>,
						<&CLK_S_D0_QUADFS 3>,
						/* Clockgen D2 */
						<0>,
						<0>,
						<0>,
						<&CLK_S_D2_QUADFS 3>,
						/* Clockgen D3 */
						<0>,
						<0>,
						<&CLK_S_D3_QUADFS 0>,
						<&CLK_S_D3_QUADFS 0>,
						<0>,
						<&CLK_S_D3_QUADFS 1>,
						<&CLK_S_D3_QUADFS 1>,
						<&CLK_S_D3_QUADFS 1>,
						<&CLK_SYSIN>,
						/* Clockgen C0 */
						<0>,
						<&CLK_S_C0_QUADFS 2>,
						<&CLK_S_C0_PLL1 0>,
						<0>,
						<0>,
						<0>,
						<&CLK_S_C0_PLL1 0>,
						<&CLK_S_C0_PLL1 0>,
						<&CLK_S_C0_QUADFS 0>,
						<&CLK_S_C0_QUADFS 0>,
						<&CLK_S_C0_PLL1 0>,
						<&CLK_S_C0_QUADFS 0>;

						/* Clockgen D0 */
		assigned-clock-rates =		<660000000>,
						<50000000>,
						<50000000>,
						<50000000>,
						<50000000>,
						<50000000>,
						<50000000>,
						<50000000>,
						<50000000>,
						/* Clockgen D2 */
						<660000000>,
						<297000000>,
						<430000000>,
						<0>,
						/* Clockgen D3 */
						<660000000>,
						<27000000>,
						<27000000>,
						<27000000>,
						<108000000>,
						<108000000>,
						<108000000>,
						<27000000>,
						<600000>,
						/* Clockgen C0 */
						<27000000>,
						<27000000>,
						<200000000>,
						<250000000>,
						<125000000>,
						<125000000>,
					        <400000000>,
						<300000000>,
						<660000000>,
						<660000000>,
						<400000000>,
						<330000000>;
	};
};
